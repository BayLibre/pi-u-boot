## board/spacemit/k3/Kconfig
```kconfig
if TARGET_SPACEMIT_K3

config SYS_BOARD
	default "k3"

config SYS_VENDOR
	default "spacemit"

config SYS_CPU
	default "x100"

config SYS_CONFIG_NAME
	default "k3"

config TEXT_BASE
	default 0x80200000

config BOARD_SPECIFIC_OPTIONS # dummy
	def_bool y
	select SPACEMIT_X100
	select SPACEMIT_K3_DDR
	select SPL_RISCV_ACLINT
	select SPL_LOAD_BLOCK
	imply BOARD_LATE_INIT

choice
	prompt "product board"
	default K3_BOARD_ASIC

config K3_BOARD_FPGA
	bool "k3 board fpga"
	help
	  K3 (X100) target is the FPGA prototype. Selects the FPGA DDR PHY
	  init path.

config K3_BOARD_ASIC
	bool "k3 board asic"
	help
	  K3 (X100) target is the production ASIC. Selects the LPDDR4X/LPDDR5
	  training and quick-boot DDR init path.

endchoice

config BOOT_FROM_USB_DISK
	bool "boot using usb disk"
	default n
	help
	  Use a USB disk to boot.

config FDT_ADD_MEMORY_NODE
	bool "Rebuild the FDT memory node from detected DRAM before boot"
	default y
	help
	  The SPL overwrites the placeholder memory node(s) in the FIT-loaded
	  control DT with the real DRAM banks detected during DDR init, so
	  U-Boot proper sees the full memory size.

choice
	prompt "DDR quick boot framework"
	default DDR_TRAINING_UPDATE_FSBL

config DDR_TRAINING_SAVE_RESTORE
	bool "save DDR training info to local storage"
	help
	  To support quick boot, save the DDR training info during the first
	  boot and restore it on the next boot.

config DDR_TRAINING_UPDATE_FSBL
	depends on !RSA_VERIFY
	bool "write DDR training info back to fsbl image"
	help
	  To support quick boot, update the DDR training info into the fsbl
	  image during the image flash process, so the training info is
	  available during normal boot.

endchoice

endif
```

## board/zhihe/a210/riscv-boot.its
```
/dts-v1/;

/ {
	description = "ZhiHe A210 Boot FIT image";
	#address-cells = <1>;

	images {
		fdt {
			description = "DEV Device Tree";
			data = /incbin/("replace-path/a210.dtb");
			type = "flat_dt";
			arch = "riscv";
			compression = "none";
			load = <0x8c000000>;
			hash {
				algo = "sha256";
			};
		};

		opensbi {
			description = "RISC-V OpenSBI";
			data = /incbin/("replace-path/fw_dynamic.bin.gz");
			type = "firmware";
			os = "opensbi";
			arch = "riscv";
			compression = "gzip";
			load = <0x80000000>;
			entry = <0x80000000>;
			hash {
				algo = "sha256";
			};
		};

		u-boot {
			description = "U-Boot";
			data = /incbin/("replace-path/u-boot.bin.gz");
			type = "firmware";
			os = "u-boot";
			arch = "riscv";
			compression = "gzip";
			load = <0x90000000>;
			entry = <0x90000000>;
			hash {
				algo = "sha256";
			};
		};
	};

	configurations {
		default = "a210";
		a210 {
			description = "A210 Configuration";
			fdt = "fdt";
			firmware = "opensbi";
			loadables = "u-boot";
			invalid_signature {
				algo = "sha256,rsa2048";
				key-name-hint = "signature_key_name";
				sign-images = "fdt", "firmware", "uboot";
			};
		};
	};
};
```

## configs/k3_defconfig
```kconfig
CONFIG_RISCV=y
CONFIG_TEXT_BASE=0x102000000
CONFIG_SYS_MALLOC_F_LEN=0x10000
CONFIG_SYS_MALLOC_LEN=0x8000000
CONFIG_STACK_SIZE=0x100000
CONFIG_FDT_ADD_MEMORY_NODE=y
CONFIG_NR_DRAM_BANKS=2
CONFIG_HAS_CUSTOM_SYS_INIT_SP_ADDR=y
CONFIG_CUSTOM_SYS_INIT_SP_ADDR=0x102300000
CONFIG_SYS_BOOTM_LEN=0x20000000
CONFIG_SYS_LOAD_ADDR=0x102000000
CONFIG_TARGET_SPACEMIT_K3=y
CONFIG_SPL_TEXT_BASE=0xc0801000
CONFIG_SPL=y
CONFIG_SPL_OPENSBI_LOAD_ADDR=0x100000000
CONFIG_K3_BOARD_ASIC=y
CONFIG_DDR_TRAINING_SAVE_RESTORE=y
CONFIG_ARCH_RV64I=y
CONFIG_RISCV_SMODE=y
CONFIG_RISCV_ISA_ZICBOM=y
CONFIG_SYS_CACHE_SHIFT_6=y
# CONFIG_RISCV_ISA_C is not set
# CONFIG_SPL_SMP is not set
CONFIG_FIT=y
# CONFIG_FIT_FULL_CHECK is not set
CONFIG_SPL_LOAD_FIT=y
CONFIG_SPL_HAS_LOAD_FIT_ADDRESS=y
CONFIG_SPL_LOAD_FIT_ADDRESS=0x140000000
CONFIG_SPL_FIT_IMAGE_POST_PROCESS=y
CONFIG_SUPPORT_RAW_INITRD=y
CONFIG_OF_BOARD_SETUP=y
CONFIG_MISC_INIT_R=y
CONFIG_SYS_RELOC_GD_ENV_ADDR=y
CONFIG_SYSRESET=y
CONFIG_SYSRESET_SBI=y
CONFIG_SYSRESET_CMD_RESET=y
CONFIG_BOOTDELAY=2
CONFIG_LOGLEVEL=4
CONFIG_SPL_LOGLEVEL=4
CONFIG_DISPLAY_CPUINFO=y
CONFIG_DISPLAY_BOARDINFO=y
CONFIG_SPL_SIZE_LIMIT=0x72F00
CONFIG_SPL_MAX_SIZE=0x72F00
CONFIG_SPL_BSS_START_ADDR=0xc0874000
CONFIG_SPL_BSS_MAX_SIZE=0x3000
# CONFIG_SPL_SHARES_INIT_SP_ADDR is not set
CONFIG_SPL_HAVE_INIT_STACK=y
CONFIG_SPL_STACK=0xc0880000
CONFIG_TIMER_EARLY=y
CONFIG_SPL_OPENSBI_SCRATCH_OPTIONS=0x1
CONFIG_SPL_SYS_MALLOC=y
CONFIG_SPL_HAS_CUSTOM_MALLOC_START=y
CONFIG_SPL_CUSTOM_SYS_MALLOC_ADDR=0x104000000
CONFIG_SPL_SYS_MALLOC_SIZE=0x2000000
# CONFIG_SPL_SYS_MALLOC_CLEAR_ON_INIT is not set
CONFIG_SPL_SYS_MALLOC_F_LEN=0x4800
CONFIG_SPL_CRC32=y
# CONFIG_SPL_SHA1 is not set
# CONFIG_SPL_SHA256 is not set
CONFIG_SPL_LZO=y
CONFIG_SYS_CBSIZE=512
CONFIG_SYS_PBSIZE=532
CONFIG_HUSH_PARSER=y
CONFIG_DEFAULT_DEVICE_TREE="k3-pico-itx"
CONFIG_ENV_OVERWRITE=y
CONFIG_OF_BOARD=y
CONFIG_ENV_IS_NOWHERE=y
CONFIG_SYS_NS16550=y
CONFIG_SYS_NS16550_MEM32=y
CONFIG_BAUDRATE=115200
CONFIG_DM_SERIAL=y
CONFIG_SPL_DM_SERIAL=y
CONFIG_SPL_SERIAL=y
CONFIG_DEBUG_UART=y
CONFIG_DEBUG_UART_NS16550=y
CONFIG_DEBUG_UART_BASE=0xd4017000
CONFIG_DEBUG_UART_CLOCK=14745600
CONFIG_DEBUG_UART_SHIFT=2
CONFIG_DEBUG_UART_ANNOUNCE=y
CONFIG_DEBUG_UART_NS16550_CHECK_ENABLED=y
CONFIG_DM_RESET=y
CONFIG_SPL_DM_RESET=y
CONFIG_RESET_SPACEMIT_K3=y
CONFIG_RAM=y
CONFIG_SPL_RAM=y
CONFIG_CLK=y
CONFIG_SPL_CLK=y
CONFIG_SPL_CLK_CCF=y
CONFIG_SPACEMIT_K3_CCU=y
CONFIG_SPL_ENV_SUPPORT=y
# CONFIG_SPL_USE_TINY_PRINTF is not set
CONFIG_MISC=y
CONFIG_SPL_MISC=y
CONFIG_USB=y
CONFIG_DM_USB=y
# CONFIG_SPL_DM_USB is not set
CONFIG_USB_DWC3=y
CONFIG_USB_DWC3_GENERIC=y
CONFIG_SPL_USB_DWC3_GENERIC=y
CONFIG_USB_GADGET=y
CONFIG_USB_GADGET_DOWNLOAD=y
CONFIG_USB_GADGET_VENDOR_NUM=0x361c
CONFIG_USB_GADGET_PRODUCT_NUM=0x1001
CONFIG_SPL_USB_GADGET=y
CONFIG_DM_USB_GADGET=y
CONFIG_SPL_DM_USB_GADGET=y
CONFIG_USB_FUNCTION_FASTBOOT=y
CONFIG_FASTBOOT_BUF_ADDR=0x140000000
CONFIG_FASTBOOT_BUF_SIZE=0x20000000
CONFIG_FASTBOOT_FLASH=y
CONFIG_FASTBOOT_FLASH_BLOCK=y
CONFIG_FASTBOOT_FLASH_BLOCK_INTERFACE_NAME="scsi"
CONFIG_FASTBOOT_FLASH_BLOCK_DEVICE_ID=0
CONFIG_FASTBOOT_FLASH_SPI=y
CONFIG_SPL_FASTBOOT=y
CONFIG_SPL_FASTBOOT_LOAD=y
CONFIG_FASTBOOT_OEM_RUN=y
CONFIG_RANDOM_UUID=y
CONFIG_PHY=y
CONFIG_SPL_PHY=y
CONFIG_PHY_SPACEMIT_K1X_USB2=y
CONFIG_SPL_PHY_SPACEMIT_K1X_USB2=y
CONFIG_PHY_SPACEMIT_K3_USB3=y
CONFIG_SPL_PHY_SPACEMIT_K3_USB3=y
CONFIG_DM_SPI=y
CONFIG_SPL_DM_SPI=y
CONFIG_SPI=y
CONFIG_SPL_SPI=y
CONFIG_SPI_MEM=y
CONFIG_K1X_QSPI=y
CONFIG_K1X_SPI=y
CONFIG_DM_MTD=y
CONFIG_SPI_FLASH_SUPPORT=y
CONFIG_SPL_SPI_FLASH_SUPPORT=y
CONFIG_SPI_FLASH=y
CONFIG_DM_SPI_FLASH=y
CONFIG_SPL_DM_SPI_FLASH=y
CONFIG_SPI_FLASH_GIGADEVICE=y
CONFIG_SPI_FLASH_WINBOND=y
CONFIG_SPI_FLASH_MTD=y
CONFIG_SPL_SPI_LOAD=y
CONFIG_SYS_SPI_U_BOOT_OFFS=0x210000
CONFIG_CMD_MTD=y
CONFIG_CMD_MTDPARTS=y
CONFIG_MTDIDS_DEFAULT="nor0=d420c000.spi"
CONFIG_MTDPARTS_DEFAULT="d420c000.spi:128K@0(bootinfo),512K@128K(fsbl),64K@640K(env),1M@704K(esos),384K@1728K(opensbi),-@2112K(uboot)"
CONFIG_PINCTRL=y
CONFIG_SPL_PINCTRL=y
CONFIG_PINCTRL_SINGLE=y
CONFIG_DM_GPIO=y
CONFIG_K1X_GPIO=y
CONFIG_CMD_DM=y
CONFIG_CMD_I2C=y
CONFIG_DM_I2C=y
CONFIG_SPL_I2C=y
# CONFIG_SPL_DM_I2C is not set
CONFIG_SPL_SYS_I2C_LEGACY=y
CONFIG_SYS_I2C_SPACEMIT=y
CONFIG_SPL_SYS_I2C_SPACEMIT=y
CONFIG_SPACEMIT_K1X_EFUSE=y
CONFIG_MMC=y
CONFIG_SPL_MMC=y
CONFIG_DM_MMC=y
CONFIG_SPL_DM_MMC=y
CONFIG_MMC_IO_VOLTAGE=y
CONFIG_MMC_UHS_SUPPORT=y
CONFIG_MMC_HS400_ES_SUPPORT=y
CONFIG_SPL_MMC_HS400_ES_SUPPORT=y
CONFIG_MMC_HS400_SUPPORT=y
CONFIG_SPL_MMC_HS400_SUPPORT=y
# CONFIG_MMC_VERBOSE is not set
CONFIG_MMC_SDHCI=y
CONFIG_MMC_SDHCI_ADMA=y
CONFIG_MMC_SDHCI_K1X=y
CONFIG_SCSI=y
CONFIG_CMD_SCSI=y
CONFIG_UFS=y
CONFIG_SPACEMIT_K3_UFS=y
CONFIG_CMD_UFS=y
# CONFIG_SPL_UFS_SUPPORT is not set
CONFIG_PCI=y
CONFIG_CMD_PCI=y
CONFIG_PCIE_DW_SPACEMIT=y
CONFIG_PHY_SPACEMIT_PCIE=y
CONFIG_NVME_PCI=y
CONFIG_POWER_DOMAIN=y
CONFIG_K3_POWER_DOMAIN=y
CONFIG_DM_PMIC=y
# CONFIG_SPL_DM_PMIC is not set
CONFIG_PMIC_SPM8XX=y
CONFIG_DM_REGULATOR=y
CONFIG_DM_REGULATOR_FIXED=y
CONFIG_DM_REGULATOR_SPM8XX=y
CONFIG_DM_REGULATOR_SPACEMIT_HUB=y
CONFIG_SPL_POWER=y
CONFIG_SPL_SPACEMIT_POWER=y
CONFIG_CMDLINE=y
CONFIG_BOOTSTD=y
CONFIG_BOOTSTD_FULL=y
CONFIG_BOOTMETH_ANDROID=y
CONFIG_ANDROID_BOOT_IMAGE=y
CONFIG_CMD_ABOOTIMG=y
CONFIG_CMD_BOOTI=y
CONFIG_ANDROID_AB=y
CONFIG_CMD_BCB=y
CONFIG_LIBAVB=y
CONFIG_AVB_VERIFY=y
CONFIG_AVB_BUF_ADDR=0x140000000
CONFIG_AVB_BUF_SIZE=0x20000000
CONFIG_CMD_AVB=y
CONFIG_EFI_PARTITION=y
CONFIG_PARTITION_TYPE_GUID=y
CONFIG_PARTITION_UUIDS=y
CONFIG_CMD_GPT=y
CONFIG_CMD_GPT_RENAME=y
CONFIG_USE_BOOTCOMMAND=y
CONFIG_BOOTCOMMAND="bootflow scan -lb"
CONFIG_USB_HOST=y
CONFIG_USB_XHCI_HCD=y
CONFIG_USB_STORAGE=y
CONFIG_CMD_USB=y
CONFIG_CMD_USB_MASS_STORAGE=y
CONFIG_TYPEC_TCPM=y
CONFIG_TYPEC_FUSB302=y
CONFIG_HWMON_SENSORS_CTF2301=y
CONFIG_RT7451_RETIMER=y
CONFIG_DM_PWM=y
CONFIG_PWM_PXA=y
CONFIG_PHYLIB=y
CONFIG_PHY_REALTEK=y
CONFIG_RTL8211F_PHY_FORCE_EEE_RXC_ON=y
CONFIG_SPL_REMOTEPROC_K3_PROC=y
CONFIG_ESPI=y
CONFIG_DM_ESPI=y
CONFIG_ESPI_SPACEMIT_K3=y
CONFIG_CROS_EC=y
CONFIG_CROS_EC_ESPI=y
CONFIG_I2C_CROS_EC_TUNNEL=y
CONFIG_INPUT=y
CONFIG_DM_KEYBOARD=y
CONFIG_CROS_EC_KEYB=y
```

## drivers/clk/spacemit/Kconfig
```kconfig
# SPDX-License-Identifier: GPL-2.0
config SPACEMIT_K3_CCU
	bool "Clock support for SpacemiT K3 (X100) SoC"
	depends on TARGET_SPACEMIT_K3
	select CLK
	select CLK_CCF
	help
	  Enable the clock controller unit (CCU) driver for the SpacemiT
	  K3 (X100) SoC. Provides the PLLs, muxes, dividers and gates for
	  the CPU clusters, the interconnect (topd/axi/cci550) and the
	  peripheral clocks.
```

## drivers/ddr/spacemit/Kconfig
```kconfig
# SPDX-License-Identifier: GPL-2.0+
#
# Copyright (c) 2025-2026 Spacemit, Inc

config SPACEMIT_K3_DDR
	bool "SpacemiT K3 (X100) DDR controller and PHY init"
	depends on TARGET_SPACEMIT_K3
	default y if TARGET_SPACEMIT_K3
	help
	  Enable the SpacemiT K3 (X100) DDR driver. It runs in the SPL/XPL
	  phase: it brings up the Synopsys DDR controller and PHY, runs DDR
	  training (LPDDR4X / LPDDR5) and supports the quick-boot path that
	  restores a previously saved training result. The large opaque
	  register/timing tables are carried verbatim from the vendor BSP.
```

## drivers/espi/Kconfig
```kconfig
menuconfig ESPI
	bool "Enhanced SPI (eSPI) support"
	help
	  Enable support for Enhanced Serial Peripheral Interface (eSPI).
	  eSPI is designed to replace the Low Pin Count (LPC) bus for
	  communication between processors and embedded controllers.

if ESPI

config DM_ESPI
	bool "Enable Driver Model for eSPI drivers"
	depends on DM
	help
	  Enable driver model for eSPI. The eSPI interface provides
	  methods to access eSPI buses and attached devices. The uclass
	  interface is defined in include/espi.h. This allows eSPI
	  controllers to be configured through device tree properties.

config ESPI_SPACEMIT_K3
	bool "SpacemiT K3 eSPI controller"
	depends on DM_ESPI
	help
	  Enable the SpacemiT K3 eSPI controller driver. This driver can be
	  used to access eSPI devices on platforms embedding this SpacemiT
	  IP core. Supports Peripheral, VWire, OOB, and Flash channels.

endif
```

## drivers/phy/spacemit/Kconfig
```kconfig
config PHY_SPACEMIT_K1X_USB2
	bool "Spacemit k1-x USB2 PHY Driver"
	depends on PHY
	help
	  Support for Spacemit k1-x USB 2 PHY

config SPL_PHY_SPACEMIT_K1X_USB2
	bool "Spacemit k1-x USB2 PHY Driver in SPL"
	depends on SPL_PHY
	help
	  Support for Spacemit k1-x USB 2 PHY in SPL

config PHY_SPACEMIT_K3_USB3
	bool "Spacemit K3 USB3/PCIE/Combo PHY driver"
	depends on PHY
	help
	  USB3 and PCIE Combo PHY Support for Spacemit k3 Soc

config SPL_PHY_SPACEMIT_K3_USB3
	bool "Spacemit K3 USB3/PCIE/Combo PHY driver in SPL"
	depends on SPL_PHY
	help
	  USB3 and PCIE Combo PHY Support for Spacemit k3 Soc in SPL

config PHY_SPACEMIT_PCIE
	bool "Spacemit K3 PCIe PHY driver"
	depends on PHY
	help
	  Support for the Spacemit k3 PCIe PHY used by the DesignWare based
	  PCIe host controller.
```

## drivers/video/spacemit/Kconfig
```kconfig
# SPDX-License-Identifier: GPL-2.0

menuconfig VIDEO_SPACEMIT
	bool "Enable SpacemiT video support"
	depends on VIDEO
	help
	  SpacemiT SoCs provide video output through the Saturn display
	  processing unit (DPU).  This enables the on-chip display
	  controller so that U-Boot can bring up a display and show a
	  splash screen before handing over to the OS.

config VIDEO_SPACEMIT_MAX_XRES
	int "Maximum horizontal resolution (for memory allocation purposes)"
	depends on VIDEO_SPACEMIT
	default 3840
	help
	  The maximum horizontal resolution to support for the framebuffer.
	  This configuration is used for reserving/allocating memory for the
	  framebuffer during device-model binding/probing.

config VIDEO_SPACEMIT_MAX_YRES
	int "Maximum vertical resolution (for memory allocation purposes)"
	depends on VIDEO_SPACEMIT
	default 2160
	help
	  The maximum vertical resolution to support for the framebuffer.
	  This configuration is used for reserving/allocating memory for the
	  framebuffer during device-model binding/probing.

if VIDEO_SPACEMIT

config DISPLAY_SPACEMIT_INNO_DP
	bool "Innosilicon DisplayPort"
	select DISPLAY
	help
	  This enables the Innosilicon DisplayPort transmitter found on
	  SpacemiT K3 (X100), including its PHY and link training.  It
	  drives a DP sink either directly or through a USB-C connector.

endif
```
